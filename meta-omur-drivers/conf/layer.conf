## meta-omur-drivers/conf/layer.conf
```bitbake
# Layer configuration for meta-omur-drivers
BBPATH .= ":${LAYERDIR}"

BBFILES += " \
    ${LAYERDIR}/recipes-*/*/*.bb \
    ${LAYERDIR}/recipes-*/*/*.bbappend \
"

BBFILE_COLLECTIONS += "omur-drivers"
BBFILE_PATTERN_omur-drivers = "^${LAYERDIR}/"
BBFILE_PRIORITY_omur-drivers = "10"

LAYERDEPENDS_omur-drivers = "core"
LAYERSERIES_COMPAT_omur-drivers = "scarthgap"
```
